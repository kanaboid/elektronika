## mikrokontrolery/esp32/waveshare-dom/a3_licznik_s3_wroom_1/main/Kconfig.projbuild
```kconfig
menu "A3 Cluster — siec i czas"

    config A3_WIFI_ENABLE
        bool "Wlacz WiFi (STA)"
        default y
        help
            Laczenie z siecia domowa. SSID i haslo ustaw ponizej
            (idf.py menuconfig -> A3 Cluster — siec i czas).

    config A3_WIFI_SSID
        string "WiFi SSID"
        default ""
        depends on A3_WIFI_ENABLE
        help
            Nazwa sieci WiFi (2.4 GHz).

    config A3_WIFI_PASSWORD
        string "WiFi haslo"
        default ""
        depends on A3_WIFI_ENABLE
        help
            Haslo WPA2 do sieci WiFi.

    config A3_NTP_SERVER
        string "Serwer NTP"
        default "pool.ntp.org"
        depends on A3_WIFI_ENABLE
        help
            Adres serwera NTP (synchronizacja zegara po polaczeniu WiFi).

endmenu
```

## mikrokontrolery/esp32/waveshare-dom/esp32-s3-wroom-1/main/Kconfig.projbuild
```kconfig
menu "Wi-Fi app configuration"

config WIFI_STA_SSID
    string "Wi-Fi SSID"
    default "SPIDERNET_114"
    help
        SSID of the access point used by station mode.

config WIFI_STA_PASSWORD
    string "Wi-Fi Password"
    default "1234554321"
    help
        Password of the access point used by station mode.
        Leave empty for an open network (no encryption).

endmenu

menu "A01NYUB (UART distance sensor)"

config A01NYUB_UART_PORT
    int "UART port number"
    default 1
    range 0 2
    help
        UART peripheral index used by A01NYUB.

config A01NYUB_UART_RX_GPIO
    int "UART RX GPIO"
    default 18
    range 0 48
    help
        ESP32 RX pin connected to A01NYUB TX data output.

config A01NYUB_MODE_GPIO
    int "Mode GPIO connected to sensor RX (-1 disabled)"
    default -1
    range -1 48
    help
        Optional dedicated GPIO wired to A01NYUB RX pin.
        -1 means mode is not controlled by firmware.

config A01NYUB_MODE_REALTIME_DEFAULT
    bool "Default mode: realtime (LOW on mode pin)"
    default n
    help
        If enabled, firmware drives mode pin LOW (realtime).
        If disabled, firmware drives mode pin HIGH (stable/smoothed).

config A01NYUB_POLL_MS
    int "Read loop interval [ms]"
    default 100
    range 20 1000
    help
        Task delay between UART polling cycles.

config A01NYUB_FRAME_TIMEOUT_MS
    int "Single frame timeout [ms]"
    default 150
    range 20 1000
    help
        UART timeout used when waiting for bytes of one frame.

config A01NYUB_STALE_MS
    int "Mark reading stale after [ms]"
    default 3000
    range 200 30000
    help
        If no valid frame appears for longer than this, reading is reported as stale.

endmenu

menu "DS18B20 (1-Wire)"

config DS18B20_GPIO_NUM
    int "DS18B20 data GPIO"
    default 4
    range 0 48
    help
        Data line to the sensor (VDD, GND, and typically 4.7k to 3.3 V).
        This project defaults to IO4; change if you use another pin.

endmenu
```
